## echo-devices/esp32p4/components/echo_audio/Kconfig
```kconfig
menu "echo_audio"

    config ECHO_AUDIO_ENABLED
        bool "Bring up the onboard microphone + speaker (ES8311)"
        default y
        help
            Calls echo_audio_init()/start() from app_main(). The board carries an
            ES8311 mono codec (analog mic on its ADC, speaker on its DAC) and an
            NS4150B power amplifier. echo_audio owns the I2S bus and reuses the
            I2C port the JD9365 display driver installs, so it must be initialised
            after echo_display_init().

    config ECHO_AUDIO_I2S_PORT
        int "I2S port (0-2 on ESP32-P4)"
        range 0 2
        default 0
        depends on ECHO_AUDIO_ENABLED

    config ECHO_AUDIO_MCLK_GPIO
        int "ES8311 MCLK GPIO"
        default 13
        depends on ECHO_AUDIO_ENABLED
        help
            Master clock the ESP32-P4 drives to the codec. GPIO13 on the
            ESP32-P4-WIFI6 (Waveshare "I2S Audio Demo").

    config ECHO_AUDIO_BCLK_GPIO
        int "ES8311 SCLK/BCLK GPIO"
        default 12
        depends on ECHO_AUDIO_ENABLED

    config ECHO_AUDIO_WS_GPIO
        int "ES8311 LRCK/WS GPIO"
        default 10
        depends on ECHO_AUDIO_ENABLED

    config ECHO_AUDIO_DOUT_GPIO
        int "ES8311 DSDIN (ESP -> codec) GPIO"
        default 9
        depends on ECHO_AUDIO_ENABLED
        help
            Playback data: the ESP32-P4 drives this line, the ES8311 DAC reads it.

    config ECHO_AUDIO_DIN_GPIO
        int "ES8311 ASDOUT (codec -> ESP) GPIO"
        default 11
        depends on ECHO_AUDIO_ENABLED
        help
            Capture data: the ES8311 ADC (microphone) drives this line.

    config ECHO_AUDIO_PA_GPIO
        int "PA_CTRL (NS4150B enable) GPIO (-1 = no PA control)"
        default 53
        depends on ECHO_AUDIO_ENABLED
        help
            The amplifier enable line is active high. echo_audio raises it only
            while playback is running so an idle board does not hiss; -1 leaves
            the pin alone (a carrier without PA control).

    config ECHO_AUDIO_I2C_PORT
        int "I2C port shared with the display driver"
        range 0 1
        default 1
        depends on ECHO_AUDIO_ENABLED
        help
            Port 1 is the bus the Waveshare JD9365 driver installs on
            SDA=GPIO7 / SCL=GPIO8 and never releases. echo_audio reuses it, so it
            must match CONFIG_ECHO_DISPLAY_* / CONFIG_ECHO_SENSORS_I2C_PORT — 1 on
            the ESP32-P4-WIFI6.

    config ECHO_AUDIO_I2C_ADDR
        hex "ES8311 7-bit I2C address"
        default 0x18
        range 0x08 0x77
        depends on ECHO_AUDIO_ENABLED

    config ECHO_AUDIO_SAMPLE_RATE_HZ
        int "Capture sample rate (Hz)"
        default 16000
        depends on ECHO_AUDIO_ENABLED
        help
            16 kHz mono matches the wake word pipeline and the Charlie upload, so
            no resampling is needed. The ES8311 also plays the server's 22050 Hz
            TTS by reconfiguring the bus around playback.

    config ECHO_AUDIO_MIC_GAIN_DB
        int "ES8311 mic gain (dB)"
        range 0 42
        default 30
        depends on ECHO_AUDIO_ENABLED
        help
            Hardware ADC gain applied to the microphone. Raise it until normal
            speech peaks around -12 dBFS; 30 dB is a sane starting point for the
            onboard analog mic.

    config ECHO_AUDIO_SPEAKER_VOLUME
        int "Speaker volume (0-100)"
        range 0 100
        default 70
        depends on ECHO_AUDIO_ENABLED

endmenu
```

## echo-devices/esp32p4/components/echo_display/Kconfig
```kconfig
menu "echo_display"

    config ECHO_DISPLAY_DSI_ENABLED
        bool "Bring up the 10.1\" DSI panel (JD9365, 800x1280)"
        default y
        help
            Creates the MIPI-DSI bus, the DPI panel and the framebuffer. The
            Waveshare driver performs the I2C power-on sequence internally
            (I2C_NUM_1, SDA=GPIO7, SCL=GPIO8, address 0x45) — do not initialise
            I2C for the panel yourself.

    config ECHO_DISPLAY_DSI_RESET_GPIO
        int "DSI panel RESET GPIO (-1 if not wired)"
        default -1
        help
            The ESP32-P4-WIFI6 wires neither LCD_RST nor TP_RST to a P4 GPIO:
            reset and backlight live behind the I2C backlight/reset controller
            at 0x45, which the Waveshare driver drives itself. Leave at -1 on
            that board. Set a real pin only for a panel that has a discrete
            reset line, and make sure the pin is not used by another peripheral.

    config ECHO_DISPLAY_DSI_BL_GPIO
        int "DSI backlight GPIO (-1 if controlled over I2C)"
        default -1
        help
            -1 means "no backlight GPIO": brightness is the controller register
            0x96 at I2C address 0x45, which the JD9365 driver already writes
            during its init sequence. This is the correct setting for the
            ESP32-P4-WIFI6, whose LCD_BL is not a GPIO. Never point this at a
            pin that another peripheral uses (an earlier revision of this
            driver forced GPIO26 high here at boot and collided with the SPI
            panel's SCLK).

    config ECHO_DISPLAY_SPI_ENABLED
        bool "Bring up the 3.5\" SPI TFT (480x320)"
        default y
        help
            Self-contained esp_lcd_panel_t implementation on SPI2_HOST; see the
            controller choice below for the pixel format. Set the GPIO numbers
            to match the actual wiring of your board.

    choice ECHO_DISPLAY_SPI_CONTROLLER
        prompt "3.5\" SPI controller"
        default ECHO_DISPLAY_SPI_CTRL_ST7796
        help
            Both controllers accept the same MIPI-DCS commands, but they differ
            in pixel format and power-on sequence.

        config ECHO_DISPLAY_SPI_CTRL_ST7796
            bool "ST7796 / ST7796S (RGB565, 2 bytes per pixel)"
            help
                Common on 3.5\" 320x480 modules sold as \"ST7796\". RGB565 is
                the native SPI format, so no pixel expansion is needed and the
                bus carries a third less data than RGB666.

        config ECHO_DISPLAY_SPI_CTRL_ILI9488
            bool "ILI9488 (RGB666, 3 bytes per pixel)"
            help
                The ILI9488 does not reliably accept RGB565 over SPI, so every
                pixel is expanded to 18-bit RGB666 before transmission.
    endchoice

    config ECHO_DISPLAY_SPI_SCLK_GPIO
        int "SPI SCLK GPIO"
        default 26

    config ECHO_DISPLAY_SPI_MOSI_GPIO
        int "SPI MOSI GPIO"
        default 23

    config ECHO_DISPLAY_SPI_CS_GPIO
        int "SPI CS GPIO"
        default 20

    config ECHO_DISPLAY_SPI_DC_GPIO
        int "SPI D/C GPIO"
        default 22

    config ECHO_DISPLAY_SPI_RST_GPIO
        int "SPI RESET GPIO (-1 if tied to 3V3)"
        default 21

    config ECHO_DISPLAY_SPI_BL_GPIO
        int "SPI backlight GPIO (-1 if tied to 3V3)"
        default -1

    config ECHO_DISPLAY_TOUCH_ENABLED
        bool "Enable touch input on the 10.1\" DSI panel"
        default y
        help
            Polls the GT911/GT9271 capacitive controller on the I2C bus the
            Waveshare driver installs (I2C_NUM_1, SDA=GPIO7, SCL=GPIO8, 100 kHz)
            and publishes ECHO_EVT_GESTURE events. The 3.5" SPI panel has no
            touch controller. Leave disabled to skip touch entirely.

    config ECHO_DISPLAY_TOUCH_SWAP_XY
        bool "Swap touch X/Y axes"
        default n
        depends on ECHO_DISPLAY_TOUCH_ENABLED
        help
            Some panel batches mount the controller rotated by 90 degrees
            relative to the display. Enable together with the matching mirror
            option if taps land on the wrong axis.

    config ECHO_DISPLAY_TOUCH_MIRROR_X
        bool "Mirror touch X axis"
        default n
        depends on ECHO_DISPLAY_TOUCH_ENABLED

    config ECHO_DISPLAY_TOUCH_MIRROR_Y
        bool "Mirror touch Y axis"
        default n
        depends on ECHO_DISPLAY_TOUCH_ENABLED

    config ECHO_DISPLAY_TOUCH_I2C_ADDR
        hex "Touch controller 7-bit I2C address"
        default 0x5D
        range 0x08 0x77
        depends on ECHO_DISPLAY_TOUCH_ENABLED
        help
            GT911/GT9271 strap their address to 0x5D or 0x14 depending on the
            INT/RST sequence at power-on. The other address is probed as a
            fallback, so either value works; set the one that stops the warning.

    config ECHO_DISPLAY_SPI_PCLK_HZ
        int "SPI pixel clock in Hz"
        range 1000000 80000000
        default 40000000
        help
            ST7796 and ILI9488 modules typically accept 40 MHz; long jumper wires
            may need 20 MHz for a stable image. The ST7796 moves 2 bytes per
            pixel against 3 for the ILI9488, so it refreshes noticeably faster at
            the same clock.

endmenu
```

## echo-devices/esp32p4/components/echo_ha/Kconfig
```kconfig
menu "echo_ha (Charlie server)"

    config ECHO_HA_ENABLED
        bool "Connect to the Charlie server at boot"
        default y
        help
            Calls echo_ha_init() + echo_ha_start() from app_main(). The client
            keeps its own WebSocket (ws://<server>:9303/ws/echo) and retries in
            the background, so a boot without Wi-Fi is not fatal.

    config ECHO_HA_SERVER_IP
        string "Charlie server address"
        default ""
        help
            IPv4 address (or hostname) of the machine running the Charlie
            server. Empty means "not provisioned": echo_ha_start() logs a
            warning and the app can still set it at runtime with
            echo_ha_set_server() or the server's setServerIp command.

    config ECHO_HA_PORT
        int "Charlie server WebSocket port"
        range 1 65535
        default 9303
        help
            9303 is what the Arduino library and the Charlie server use. Only
            change it when the server is reconfigured to match.

    config ECHO_HA_WAKE_ACCURACY_PERMILLE
        int "Initial wake word accuracy (per mille)"
        range 0 1000
        default 900
        help
            Reported to the app and overridden by the server's
            setWakeUpWordAccuracy command (which is persisted in NVS). Kept as
            per mille so it fits a Kconfig int: 900 = 0.90.

    config ECHO_HA_TTS_END_TIMEOUT_MS
        int "Silence that ends an assistant reply (ms)"
        range 200 10000
        default 1200
        help
            The protocol has no end-of-reply marker, so a gap in the binary
            audio frames closes the turn (ECHO_EVT_HA_TTS_END). Tune it against
            the server's chunk pacing: too small cuts long replies into several
            turns, too large delays the follow-up microphone.
endmenu
```

## echo-devices/esp32p4/components/echo_screen/Kconfig
```kconfig
menu "Echo screen bundles"

    config ECHO_SCREEN_ENABLED
        bool "Pull and render UI bundles from Charlie"
        default y
        help
            Enable the screen bundle renderer. The device polls Charlie for a
            revision, downloads the bundle over HTTP when the hash changed,
            caches it in SPIFFS and renders it with LVGL. Until a bundle is
            available the panels keep the "Waiting for UI from Charlie" message.

    config ECHO_SCREEN_HTTP_PORT
        int "Charlie HTTP API port"
        default 9300
        depends on ECHO_SCREEN_ENABLED
        help
            Port of the Charlie HTTP API (the WebSocket bridge uses 9303). The
            host is taken from the Charlie server address configured for the
            echo_ha component.

    config ECHO_SCREEN_POLL_INTERVAL_S
        int "Revision poll interval (seconds)"
        default 30
        range 5 3600
        depends on ECHO_SCREEN_ENABLED
        help
            How often the device asks Charlie for its current bundle revision.
            The request is a tiny JSON document; 30 s is a good default.

    config ECHO_SCREEN_REMOTE_VAR_REFRESH_MS
        int "Remote variable refresh floor (ms)"
        default 1000
        range 250 60000
        depends on ECHO_SCREEN_ENABLED
        help
            Minimum interval between two batches of `external.*` variable
            requests. Individual variables carry their own ttl in the bundle;
            this floor keeps a misconfigured bundle from flooding the server.

    config ECHO_SCREEN_BUNDLE_PATH
        string "Bundle cache path"
        default "/storage/ui/bundle.json"
        depends on ECHO_SCREEN_ENABLED
        help
            SPIFFS path of the cached bundle. A second ".prev" copy keeps the
            previous revision so a failed update never leaves the device
            without a UI.

endmenu
```

## echo-devices/esp32p4/components/echo_sensors/Kconfig
```kconfig
menu "echo_sensors"

    config ECHO_SENSORS_DHT22_ENABLED
        bool "DHT22 temperature / humidity probe"
        default y
        help
            Bit-bangs the DHT22 single-wire protocol on the GPIO below and
            publishes ECHO_EVT_TEMPERATURE once per period. Bit timings are
            measured with esp_timer_get_time() and the read runs with interrupts
            enabled, so the ~5 ms transaction does not stall the SDIO link to the
            C6; a frame corrupted by preemption fails its checksum and is
            retried. Do not poll faster than the sensor allows.

    config ECHO_SENSORS_DHT22_GPIO
        int "DHT22 data GPIO"
        default 5
        depends on ECHO_SENSORS_DHT22_ENABLED
        help
            Data line with a 4.7k-10k pull-up to 3V3. GPIO5 is free on the
            ESP32-P4-WIFI6 (the header's reserved pins are 7/8 for I2C, 9-13
            for I2S, 14-19 for SDIO, 37-45 for UART0/TF and 53/54).

    config ECHO_SENSORS_DHT22_PERIOD_MS
        int "DHT22 poll period (ms)"
        range 2000 60000
        default 5000
        depends on ECHO_SENSORS_DHT22_ENABLED
        help
            The DHT22 needs at least 2 s between reads; slower is better for
            accuracy. 5000 ms is a good compromise for a room display.

    config ECHO_SENSORS_PAJ7620_ENABLED
        bool "PAJ7620U2 air gesture sensor"
        default y
        help
            Publishes ECHO_EVT_AIR_GESTURE for up/down/left/right, forward,
            backward, clockwise, counter-clockwise and wave. The sensor hangs on
            the display's I2C bus, so echo_sensors_init() must be called after
            echo_display_init().

    config ECHO_SENSORS_PAJ7620_INT_GPIO
        int "PAJ7620U2 INT GPIO (-1 = poll only)"
        default 4
        depends on ECHO_SENSORS_PAJ7620_ENABLED
        help
            The INT output is active low and is used as a gate: the task only
            reads the gesture registers when the line is asserted. -1 makes the
            task read the registers unconditionally every poll period, which
            works but costs more I2C traffic.

    config ECHO_SENSORS_PAJ7620_I2C_ADDR
        hex "PAJ7620U2 7-bit I2C address"
        default 0x73
        range 0x08 0x77
        depends on ECHO_SENSORS_PAJ7620_ENABLED

    config ECHO_SENSORS_PAJ7620_POLL_MS
        int "PAJ7620U2 poll period (ms)"
        range 10 500
        default 30
        depends on ECHO_SENSORS_PAJ7620_ENABLED
        help
            A gesture lasts ~200 ms, so 30 ms never misses one and keeps the
            shared I2C bus (touch controller included) mostly idle.

    config ECHO_SENSORS_I2C_PORT
        int "I2C port shared with the display driver"
        range 0 1
        default 1
        depends on ECHO_SENSORS_PAJ7620_ENABLED
        help
            Port 1 is the bus the Waveshare JD9365 driver installs on
            SDA=GPIO7 / SCL=GPIO8 and never releases. echo_sensors reuses it
            instead of installing its own, so this must match
            CONFIG_ECHO_DISPLAY_* — 1 on the ESP32-P4-WIFI6.

endmenu
```
