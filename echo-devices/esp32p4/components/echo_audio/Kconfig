## echo-devices/esp32p4/components/echo_status/Kconfig
```kconfig
menu "echo_status"

    config ECHO_STATUS_ENABLED
        bool "Show a boot status screen"
        default y
        help
            Schedules a task that, once the boot has settled, paints a one-page
            diagnostic on the 10.1" panel (free RAM/PSRAM, Wi-Fi, time, sensors,
            panels, microphone and speaker) and a "Welcome to EchoCook" message
            on the 3.5" panel. Both are held for ECHO_STATUS_WINDOW_MS and then
            swapped back to whatever was on screen (the Charlie UI when a bundle
            is loaded). Requires echo_ui to be up.

    config ECHO_STATUS_DELAY_MS
        int "Delay after boot before showing the status (ms)"
        range 0 60000
        default 5000
        depends on ECHO_STATUS_ENABLED
        help
            Lets the panels, network and sensors finish coming up so the page
            shows final states instead of "down".

    config ECHO_STATUS_WINDOW_MS
        int "How long the status stays on screen (ms)"
        range 1000 120000
        default 15000
        depends on ECHO_STATUS_ENABLED
        help
            Values are refreshed about once per second while the page is up.

    config ECHO_STATUS_SHOW_AUX
        bool "Show the welcome message on the 3.5\" panel too"
        default y
        depends on ECHO_STATUS_ENABLED

    config ECHO_STATUS_PLAY_SOUND
        bool "Play a short chime while the status is shown"
        default y
        depends on ECHO_STATUS_ENABLED
        help
            Plays a two-note tone through echo_audio to prove the speaker is
            wired up. Ignored when CONFIG_ECHO_AUDIO_ENABLED is off.

endmenu
```

## echo-devices/esp32p4/components/echo_voice/Kconfig
```kconfig
menu "echo_voice"

    config ECHO_VOICE_ENABLED
        bool "Wire the wake word, microphone and Charlie upload"
        default y
        help
            Calls echo_voice_init() from app_main(). It registers the echo_audio
            monitor tap with echo_wakeword, uploads an utterance to echo_ha after
            a detection and plays the server's TTS reply. Requires echo_audio and
            echo_wakeword to be up.

    config ECHO_VOICE_UTTERANCE_MAX_MS
        int "Maximum utterance length (ms)"
        range 1000 30000
        default 8000
        help
            Hard cap on one recording so a stuck session always ends. The turn
            normally closes earlier on silence (ECHO_VOICE_SILENCE_MS).

    config ECHO_VOICE_SILENCE_MS
        int "Trailing silence that ends an utterance (ms)"
        range 300 5000
        default 900
        help
            Once the microphone has been quiet for this long the recording stops
            and "end" is sent, so the server can answer without waiting for the
            full ECHO_VOICE_UTTERANCE_MAX_MS.

    config ECHO_VOICE_SILENCE_RMS
        int "Silence RMS threshold (16-bit full scale)"
        range 1 4000
        default 250
        help
            Frames whose RMS is below this count towards the trailing silence.
            Raise it in a noisy kitchen so the room hum is treated as silence,
            lower it if quiet speech is being cut off.

    config ECHO_VOICE_TTS_RATE_HZ
        int "Server TTS sample rate (Hz)"
        default 22050
        help
            The Charlie server streams 16-bit mono PCM at 22050 Hz. echo_audio
            reconfigures the codec around the reply and restores the capture rate
            afterwards.

endmenu
```

## echo-devices/esp32p4/components/echo_wakeword/Kconfig
```kconfig
menu "echo_wakeword"

    config ECHO_WAKEWORD_ENGINE_ENABLED
        bool "Link the TFLite 'Hey Charlie' engine"
        default y
        help
            Builds engines/tflite_engine.cpp and registers it as the scoring engine.
            Requires espressif/esp-tflite-micro in src/idf_component.yml and the trained
            hey_charlie.tflite model (flash partition "model" or embedded blob).
            When disabled the component still buffers audio and exposes statistics, but
            never reports a detection.

    config ECHO_WAKEWORD_DEFAULT_THRESHOLD_PERMILLE
        int "Default detection threshold (per mille, 0-1000)"
        range 0 1000
        default 900
        help
            Detection confidence required to report a wake word, expressed as per mille so
            it fits in a Kconfig int. 900 = 0.90. The server's setWakeUpWordAccuracy
            command overrides this at runtime.

    config ECHO_WAKEWORD_VERBOSE_SCORES
        bool "Log every window score"
        default n
        help
            Extremely noisy: one log line per 10 ms hop. Enable only while tuning the
            threshold on real kitchen audio.

endmenu
```

## echo-devices/esp32p4/components/echo_wifi/Kconfig
```kconfig
menu "echo_wifi"

    config ECHO_WIFI_ENABLED
        bool "Bring up the hosted Wi-Fi station at boot"
        default y
        help
            Calls echo_wifi_connect() from app_main(). The P4 has no radio: the
            station runs through esp_wifi_remote -> esp_hosted -> ESP32-C6 over
            SDIO (see sdkconfig.defaults). Disable for display-only bring-up or
            when the C6 has no ESP-Hosted slave firmware flashed: without it
            esp_wifi_init() blocks on RPC and then times out.

    config ECHO_WIFI_SSID
        string "Wi-Fi SSID"
        default ""
        help
            Empty means "not provisioned": echo_wifi_init() returns
            ESP_ERR_INVALID_STATE instead of scanning forever. There is no
            captive portal / SoftAP fallback in this phase.

    config ECHO_WIFI_PASSWORD
        string "Wi-Fi password"
        default ""
        help
            Empty selects an open network (auth mode OPEN). Anything else is
            connected with WPA2-PSK as the minimum accepted auth mode.

    config ECHO_WIFI_MAX_RETRY
        int "Reconnect attempts before giving up (0 = forever)"
        range 0 100
        default 0
        help
            A failed attempt costs ECHO_WIFI_RETRY_DELAY_MS. The counter is reset
            on IP_EVENT_STA_GOT_IP. With 0 the station keeps retrying and only
            logs the disconnect reason, which is what a kitchen appliance wants.

    config ECHO_WIFI_RETRY_DELAY_MS
        int "Delay between reconnect attempts (ms)"
        range 500 60000
        default 3000

    config ECHO_WIFI_HOSTNAME
        string "DHCP hostname"
        default "echo-cook"
        help
            Sent in the DHCP request so the router's client list shows a name
            instead of a MAC address.

    config ECHO_WIFI_NTP_ENABLED
        bool "Start SNTP once an IP address is obtained"
        default y
        help
            Launches an SNTP client after the station gets an IP address so
            time()/localtime_r() return wall-clock time (used by the boot status
            screen and the core.time.* bundle variables). Without it the clock
            stays at the 1970 epoch and those values show as "not synced".

    config ECHO_WIFI_NTP_SERVER
        string "NTP server"
        default "pool.ntp.org"
        depends on ECHO_WIFI_NTP_ENABLED
        help
            Hostname or IP of the NTP server. The system timezone is set from
            ECHO_WIFI_TZ before the first localtime_r() call.

    config ECHO_WIFI_TZ
        string "POSIX timezone (TZ)"
        default "CET-1CEST,M3.5.0,M10.5.0/3"
        depends on ECHO_WIFI_NTP_ENABLED
        help
            POSIX TZ string used to render local time, e.g. "UTC0" or
            "CET-1CEST,M3.5.0,M10.5.0/3" (Central Europe). Applied with
            setenv("TZ", ...)/tzset() when SNTP starts.

endmenu
```
